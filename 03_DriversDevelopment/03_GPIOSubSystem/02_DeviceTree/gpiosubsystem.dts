/dts-v1/;
/plugin/;

/ {
    compatible = "brcm,bcm2837";

    fragment@0 {
        target = <&gpio>;
        __overlay__ {
            /* Nothing to overlay directly on the GPIO controller itself here */
        };
    };

    fragment@1 {
        target-path = "/";
        __overlay__ {
            gpiosubsystem: gpiosubsystem {
                compatible = "gpio-descriptor-based";
                led27-gpios = <&gpio 27 0>;  /* GPIO27 active low */
                status = "okay";
            };
        };
    };
};
